## kernel/Kconfig
```kconfig
# SPDX-License-Identifier: ISC
# Kyronix kernel configuration
#
# Use 'make nconfig' to edit, or edit .config directly.

mainmenu "Kyronix Kernel Configuration"

config KMEMLEAK
	bool "Kernel memory leak detector"
	default y
	help
	  Enable kmemleak to track kernel heap and page allocations.
	  Scans data/bss, heap, page tables, and kernel stacks to
	  detect unreferenced objects.

config SERIAL_CONSOLE
	bool "Serial console (COM1) for TTY I/O"
	default y
	help
	  When enabled, TTY input/output is routed through the COM1 serial
	  port (UART 16550 at 0x3F8). Disable this if you only want TTY
	  interaction via framebuffer console + PS/2 keyboard.

config LOG_LEVEL
	int "Default kernel log level (0-3)"
	range 0 3
	default 1
	help
	  0=KLOG_ERROR   (only errors)
	  1=KLOG_WARN    (errors + warnings, default)
	  2=KLOG_INFO    (errors + warnings + info)
	  3=KLOG_DEBUG   (all messages)
```
